## sdkconfig.defaults
```kconfig
CONFIG_IDF_TARGET="esp32s3"
CONFIG_ESP_MAIN_TASK_STACK_SIZE=8192
CONFIG_ESPTOOLPY_FLASHSIZE_4MB=y
CONFIG_SPIRAM=y
CONFIG_SPIRAM_MODE_OCT=y
CONFIG_PARTITION_TABLE_CUSTOM=y
CONFIG_PARTITION_TABLE_CUSTOM_FILENAME="partitions.csv"
CONFIG_COMPILER_CXX_EXCEPTIONS=y
CONFIG_LV_CONF_SKIP=n
CONFIG_ESP_PANEL_BOARD_FILE_SKIP=y
CONFIG_ESP_PANEL_DRIVERS_FILE_SKIP=y
CONFIG_ESP_PANEL_BOARD_DEFAULT_USE_SUPPORTED=y
CONFIG_ESP_PANEL_BOARD_MANUFACTURER_ELECROW=y
CONFIG_BOARD_ELECROW_CROWPANEL_7_0=y
CONFIG_ESP_PANEL_DRIVERS_BUS_USE_RGB=y
CONFIG_ESP_PANEL_DRIVERS_BUS_USE_I2C=y
CONFIG_ESP_PANEL_DRIVERS_LCD_USE_EK9716B=y
CONFIG_ESP_PANEL_DRIVERS_TOUCH_USE_GT911=y
CONFIG_ESP_PANEL_DRIVERS_BACKLIGHT_USE_SWITCH_GPIO=y
CONFIG_ESP_PANEL_DRIVERS_EXPANDER_USE_TCA95XX_8BIT=y
```
